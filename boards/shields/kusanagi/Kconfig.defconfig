## boards/shields/kusanagi/Kconfig.defconfig
```kconfig
if SHIELD_KUSANAGI

# Name must be less than 16 characters long!
config ZMK_KEYBOARD_NAME
    default "KUSANAGI"

config ZMK_SPLIT
	default n

config USB_DEVICE_PRODUCT
	default "KUSANAGI"

config USB_DEVICE_VID
	default "0x0000"

config USB_DEVICE_PID
	default "0xFEED"

config USB_DEVICE_MANUFACTURER
	default "eztrow"

endif
```
